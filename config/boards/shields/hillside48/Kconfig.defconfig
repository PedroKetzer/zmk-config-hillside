## config/boards/shields/hillside48/Kconfig.defconfig
```kconfig
# Copyright (c) 2021 The ZMK Contributors
# SPDX-License-Identifier: MIT

if SHIELD_HILLSIDE48_LEFT

config ZMK_KEYBOARD_NAME
    default "Hillside48"

config ZMK_SPLIT_BLE_ROLE_CENTRAL
    default y

endif

if SHIELD_HILLSIDE48_LEFT || SHIELD_HILLSIDE48_RIGHT

config ZMK_SPLIT
    default y

config CONFIG_ZMK_SPLIT_BLE_CENTRAL_BATTERY_LEVEL_FETCHING
    default y

CONFIG_ZMK_SPLIT_BLE_CENTRAL_BATTERY_LEVEL_PROXY
    default y

endif
```
